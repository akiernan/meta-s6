## conf/distro/include/init-manager-s6-linux-init-s6-rc.inc
```bitbake
# enable s6-linux-init/s6-rc for init
DISTRO_FEATURES_OPTED_OUT:append = " sysvinit systemd"
VIRTUAL-RUNTIME_init_manager ??= "s6-linux-init"
VIRTUAL-RUNTIME_initscripts ??= ""
VIRTUAL-RUNTIME_login_manager ??= "busybox"
VIRTUAL-RUNTIME_dev_manager ??= "udev"
S6_LINUX_INIT_SERVICE_MANAGER ??= "s6-rc"
```

## conf/distro/include/maintainers.inc
```bitbake
RECIPE_MAINTAINER:pn-dnsfunnel = "Alex Kiernan <alex.kiernan@gmail.com>"
RECIPE_MAINTAINER:pn-execline = "Alex Kiernan <alex.kiernan@gmail.com>"
RECIPE_MAINTAINER:pn-mdevd = "Alex Kiernan <alex.kiernan@gmail.com>"
RECIPE_MAINTAINER:pn-nsss = "Alex Kiernan <alex.kiernan@gmail.com>"
RECIPE_MAINTAINER:pn-s6 = "Alex Kiernan <alex.kiernan@gmail.com>"
RECIPE_MAINTAINER:pn-s6-dns = "Alex Kiernan <alex.kiernan@gmail.com>"
RECIPE_MAINTAINER:pn-s6-linux-init = "Alex Kiernan <alex.kiernan@gmail.com>"
RECIPE_MAINTAINER:pn-s6-linux-utils = "Alex Kiernan <alex.kiernan@gmail.com>"
RECIPE_MAINTAINER:pn-s6-networking = "Alex Kiernan <alex.kiernan@gmail.com>"
RECIPE_MAINTAINER:pn-s6-portable-utils = "Alex Kiernan <alex.kiernan@gmail.com>"
RECIPE_MAINTAINER:pn-s6-rc = "Alex Kiernan <alex.kiernan@gmail.com>"
RECIPE_MAINTAINER:pn-shibari = "Alex Kiernan <alex.kiernan@gmail.com>"
RECIPE_MAINTAINER:pn-skalibs = "Alex Kiernan <alex.kiernan@gmail.com>"
RECIPE_MAINTAINER:pn-smtpd-starttls-proxy = "Alex Kiernan <alex.kiernan@gmail.com>"
RECIPE_MAINTAINER:pn-tipidee = "Alex Kiernan <alex.kiernan@gmail.com>"
RECIPE_MAINTAINER:pn-utmps = "Alex Kiernan <alex.kiernan@gmail.com>"
```
